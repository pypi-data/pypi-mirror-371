#pragma once
#include <Arduino.h>
#include <tensorflow-runtime-universal.h>

#ifdef __has_attribute
#define HAVE_ATTRIBUTE(x) __has_attribute(x)
#else
#define HAVE_ATTRIBUTE(x) 0
#endif
#if HAVE_ATTRIBUTE(aligned) || (defined(__GNUC__) && !defined(__clang__))
#define DATA_ALIGN_ATTRIBUTE __attribute__((aligned(4)))
#else
#define DATA_ALIGN_ATTRIBUTE
#endif

namespace tinyml4all {
    template<size_t tensorArenaSize>
    class CNN2D {
        public:
            const size_t numInputs = 6912;
            const size_t numOutputs = 2;
            const size_t numOps = 8;
            

            const Model *model;
            MicroMutableOpResolver<8> resolver;
            MicroInterpreter *interpreter;
            TfLiteTensor *in;
            TfLiteTensor *out;
            uint8_t arena[tensorArenaSize];
            float outputs[2];
            float confidence;
            String label;
            size_t runtime_ms;

            /**
             * Constructor
             */
            CNN2D() :
                model(nullptr),
                interpreter(nullptr),
                in(nullptr),
                out(nullptr),
                label(""),
                _registered(false),
                _error("") {

                for (uint8_t i = 0; i < numOutputs; i++)
                    outputs[i] = 0;
            }

            /**
             * Test if model failed
             */
            inline bool failed() {
                return _error.length() > 0;
            }

            /**
             * Get error message
             */
            inline String error() {
                return _error;
            }

            /**
             * Test if input is float
             */
            inline bool isFloatInput() const {
                return in->type == kTfLiteFloat32;
            }

            /**
             * Test if input is int8
             */
            inline bool isInt8Input() const {
                return in->type == kTfLiteInt8;
            }

            /**
             * Test if output is float
             */
            inline bool isFloatOutput() const {
                return out->type == kTfLiteFloat32;
            }

            /**
             * Test if output is int8
             */
            inline bool isInt8Output() const {
                return out->type == kTfLiteInt8;
            }

            /**
             * Get i-th output
             */
            float output(uint16_t i = 0) {
                if (outputs == NULL || i >= numOutputs)
                    return sqrt(-1);

                return outputs[i];
            }

            /**
             * Init model
             */
            bool begin() {
                registerOps();
                model = tflite::GetModel(data);

                if (model->version() != TFLITE_SCHEMA_VERSION)
                    return fail(String("Model version mismatch. Expected ") + TFLITE_SCHEMA_VERSION + ", got " + model->version());

                interpreter = tf::newInterpreter<8>(&resolver, model, arena, tensorArenaSize);

                if (interpreter->AllocateTensors() != kTfLiteOk)
                    return fail("AllocateTensors() failed");

                in = interpreter->input(0);
                out = interpreter->output(0);

                if (!isFloatInput() && !isInt8Input())
                    return fail("Only float and int8 inputs are supported");

                if (!isFloatOutput() && !isInt8Output())
                    return fail("Only float and int8 outputs are supported");

                return fail();
            }

            /**
             * Predict float input
             */
            bool predict(float *x) {
                const float inputScale = in->params.scale == 0 ? 1 : in->params.scale;
                const float inputOffset = in->params.zero_point;
                const float outputScale = out->params.scale == 0 ? 1 : out->params.scale;
                const float outputOffset = out->params.zero_point;
                const size_t startedAt = millis();

                if (model == nullptr && !begin())
                    return false;

                if (failed())
                    return false;

                // set (quantized) input
                if (isFloatInput())
                  for (uint16_t i = 0; i < numInputs; i++)
                      in->data.f[i] = x[i];
                else
                  for (uint16_t i = 0; i < numInputs; i++)
                      in->data.int8[i] = static_cast<int8_t>((float) x[i] / inputScale + inputOffset);

                if (interpreter->Invoke() != kTfLiteOk)
                    return fail("Invoke() failed");

                // get (quantized) output
                if (isFloatOutput())
                    for (uint16_t i = 0; i < numOutputs; i++)
                      outputs[i] = out->data.f[i];
                else
                  for (uint16_t i = 0; i < numOutputs; i++)
                      outputs[i] = ((float) out->data.int8[i] - outputOffset) * outputScale;

                getClassificationResult();
                runtime_ms = millis() - startedAt;

                return fail();
            }

            /**
             * Predict int8 input
             */
            bool predict(int8_t *x) {
                const float inputScale = in->params.scale == 0 ? 1 : in->params.scale;
                const float inputOffset = in->params.zero_point;
                const float outputScale = out->params.scale == 0 ? 1 : out->params.scale;
                const float outputOffset = out->params.zero_point;
                const size_t startedAt = millis();

                if (model == nullptr && !begin())
                    return false;

                if (failed())
                    return false;

                // set (quantized) input
                if (isFloatInput())
                  for (uint16_t i = 0; i < numInputs; i++)
                      in->data.f[i] = x[i];
                else
                  for (uint16_t i = 0; i < numInputs; i++)
                      in->data.int8[i] = static_cast<int8_t>((float) x[i] / inputScale + inputOffset);

                if (interpreter->Invoke() != kTfLiteOk)
                    return fail("Invoke() failed");

                // get (quantized) output
                if (isFloatOutput())
                    for (uint16_t i = 0; i < numOutputs; i++)
                      outputs[i] = out->data.f[i];
                else
                  for (uint16_t i = 0; i < numOutputs; i++)
                      outputs[i] = ((float) out->data.int8[i] - outputOffset) * outputScale;

                getClassificationResult();
                runtime_ms = millis() - startedAt;

                return fail();
            }

            /**
             * Predict uint8 (mainly images)
             */
             bool predict(uint8_t *x) {
                const float inputScale = in->params.scale == 0 ? 1 : in->params.scale;
                const float inputOffset = in->params.zero_point;
                const float outputScale = out->params.scale == 0 ? 1 : out->params.scale;
                const float outputOffset = out->params.zero_point;
                const size_t startedAt = millis();

                if (model == nullptr && !begin())
                    return false;

                if (failed())
                    return false;

                // set (quantized) input
                if (isFloatInput())
                  for (uint16_t i = 0; i < numInputs; i++)
                      in->data.f[i] = x[i];
                else
                  for (uint16_t i = 0; i < numInputs; i++)
                      in->data.int8[i] = static_cast<int8_t>((float) x[i] / inputScale + inputOffset);

                if (interpreter->Invoke() != kTfLiteOk)
                    return fail("Invoke() failed");

                // get (quantized) output
                if (isFloatOutput())
                    for (uint16_t i = 0; i < numOutputs; i++)
                      outputs[i] = out->data.f[i];
                else
                  for (uint16_t i = 0; i < numOutputs; i++)
                      outputs[i] = ((float) out->data.int8[i] - outputOffset) * outputScale;

                getClassificationResult();
                runtime_ms = millis() - startedAt;

                return fail();
             }

             /**
             * Predict uint8 (mainly images)
             */
             bool predict(const uint8_t *x) {
                const float inputScale = in->params.scale == 0 ? 1 : in->params.scale;
                const float inputOffset = in->params.zero_point;
                const float outputScale = out->params.scale == 0 ? 1 : out->params.scale;
                const float outputOffset = out->params.zero_point;
                const size_t startedAt = millis();

                if (model == nullptr && !begin())
                    return false;

                if (failed())
                    return false;

                // set (quantized) input
                if (isFloatInput())
                  for (uint16_t i = 0; i < numInputs; i++)
                      in->data.f[i] = x[i];
                else
                  for (uint16_t i = 0; i < numInputs; i++)
                      in->data.int8[i] = static_cast<int8_t>((float) x[i] / inputScale + inputOffset);

                if (interpreter->Invoke() != kTfLiteOk)
                    return fail("Invoke() failed");

                // get (quantized) output
                if (isFloatOutput())
                    for (uint16_t i = 0; i < numOutputs; i++)
                      outputs[i] = out->data.f[i];
                else
                  for (uint16_t i = 0; i < numOutputs; i++)
                      outputs[i] = ((float) out->data.int8[i] - outputOffset) * outputScale;

                getClassificationResult();
                runtime_ms = millis() - startedAt;

                return fail();
             }

            /**
             * Convert results to String for debug
             */
            String outputsAsString() {
              String result = "";
              result.reserve(numOutputs * 6);

              for (int i = 0; i < numOutputs; i++) {
                if (i > 0)
                  result += ", ";

                result += outputs[i];
              }

              return result;
            }

        protected:
            bool _registered;
            String _error;

            /**
             * Register ops in resolver
             */
            void registerOps() {
                if (_registered)
                    return;

                resolver.AddDequantize();
                resolver.AddMaxPool2D();
                resolver.AddSoftmax();
                resolver.AddQuantize();
                resolver.AddConv2D();
                resolver.AddFullyConnected();
                resolver.AddReshape();
                resolver.AddShape();
                
                _registered = true;
            }

            /**
             * Set error message, if any
             */
            bool fail(String message = "") {
                _error = message;

                // return true if error is empty (success)
                return _error.length() == 0;
            }

            /**
             * If classification, get most probable class
             */
            void getClassificationResult() {
                if (numOutputs < 2)
                    return;

                confidence = outputs[0];
                uint8_t ix = 0;

                for (uint16_t i = 1; i < numOutputs; i++) {
                    if (outputs[i] > confidence) {
                        ix = i;
                        confidence = outputs[i];
                    }
                }

                
                    label = String(ix);
                
            }

            const unsigned char data[13672] DATA_ALIGN_ATTRIBUTE = { 0x1c, 0x00, 0x00, 0x00, 0x54, 0x46, 0x4c, 0x33, 0x14, 0x00, 0x20, 0x00, 0x1c,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 0x00, 0x03 };
    };
}